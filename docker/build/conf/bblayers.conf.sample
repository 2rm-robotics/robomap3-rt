## docker/build/conf/bblayers.conf.sample
```bitbake
# POKY_BBLAYERS_CONF_VERSION is increased each time build/conf/bblayers.conf
# changes incompatibly
POKY_BBLAYERS_CONF_VERSION = "2"

BBPATH = "${TOPDIR}"
BBFILES ?= "" 

BBLAYERS ?= " \
  /workdir/poky-krogoth-15.0.3/meta \
  /workdir/poky-krogoth-15.0.3/meta-poky \
  /workdir/poky-krogoth-15.0.3/meta-yocto-bsp \
  /workdir/robomap3-rt/meta-external/meta-oe \
  /workdir/robomap3-rt/meta-external/meta-qt4 \
  /workdir/robomap3-rt/meta-external/meta-python \
  /workdir/robomap3-rt/meta-external/meta-ros \
  /workdir/robomap3-rt/meta-external/meta-isee \
  /workdir/robomap3-rt/meta-xenomai-omap \
  /workdir/robomap3-rt/meta-kernel-omap \
  /workdir/robomap3-rt/meta-poky \
  /workdir/robomap3-rt/meta-external/meta-raspberrypi \
  /workdir/robomap3-rt/meta-external/meta-rpi \
  "
```

## meta-external/meta-isee/conf/distro/release.inc
```bitbake
#
# Distro tracking versions
#
ISEE_SUBVERSION = "2"
SDK_SUBVERSION = "${ISEE_SUBVERSION}"
EXTRAVERSION = ""
```

## meta-external/meta-oe/conf/layer.conf
```bitbake
# We have a conf and classes directory, add to BBPATH
BBPATH .= ":${LAYERDIR}"

# We have recipes-* directories, add to BBFILES
BBFILES += "${LAYERDIR}/recipes-*/*/*.bb \
            ${LAYERDIR}/recipes-*/*/*.bbappend"

BBFILE_COLLECTIONS += "meta-oe"
BBFILE_PATTERN_meta-oe := "^${LAYERDIR}/"

#low priority. If a same recipe exists in poky, we prefer poky version.
BBFILE_PRIORITY_meta-oe = "4"
```

## meta-external/meta-raspberrypi/conf/machine/include/rpi-default-providers.inc
```bitbake
# RaspberryPi BSP default providers

PREFERRED_PROVIDER_virtual/kernel ?= "linux-raspberrypi"
PREFERRED_PROVIDER_virtual/xserver ?= "xserver-xorg"
#PREFERRED_PROVIDER_virtual/egl ?= "userland"
PREFERRED_PROVIDER_virtual/egl ?= "mesa"
#PREFERRED_PROVIDER_virtual/libgles2 ?= "userland"
PREFERRED_PROVIDER_virtual/libgles2 ?= "mesa"
#PREFERRED_PROVIDER_virtual/libgl ?= "mesa-gl"
PREFERRED_PROVIDER_virtual/libgl ?= "mesa"
#PREFERRED_PROVIDER_virtual/mesa ?= "mesa-gl"
PREFERRED_PROVIDER_virtual/mesa ?= "mesa"
PREFERRED_PROVIDER_jpeg ?= "jpeg"
```

## meta-kernel-omap/conf/layer.conf
```bitbake
# We have a conf and classes directory, add to BBPATH
BBPATH .= ":${LAYERDIR}"

# We have recipes-* directories, add to BBFILES
BBFILES += "${LAYERDIR}/recipes-*/*/*.bb \
            ${LAYERDIR}/recipes-*/*/*.bbappend"

BBFILE_COLLECTIONS += "meta-kernelomap"
BBFILE_PATTERN_meta-kernelomap := "^${LAYERDIR}/"
BBFILE_PRIORITY_meta-kernelomap = "7"
```

## meta-poky/conf/distro/robomap3-tiny.conf
```bitbake
require conf/distro/poky-tiny.conf
DISTRO = "robomap3-tiny"

DISTRO_FEATURES_LIBC += "libc-locale-code libc-ftraverse libc-fcvt libc-posix-clang-wchar libc-posix-wchar-io"
ENABLE_WIDEC = "true"
```

## meta-poky/conf/distro/robomap3.conf
```bitbake
#this distro is equal to poky, except for the default extract path of the sdk
#we add a defautltune directory to the default extract path
#this allows to have host and target toolchains in same parent dir (eg /opt/poky/1.7/)

require conf/distro/poky.conf
DISTRO = "robomap3"
GCCVERSION = "4.9.3"

SDKPATH = "/opt/${DISTRO}/${SDK_VERSION}/${DEFAULTTUNE}"
```

## meta-poky/conf/layer.conf
```bitbake
# We have a conf and classes directory, add to BBPATH
BBPATH .= ":${LAYERDIR}"

# We have recipes-* directories, add to BBFILES
BBFILES += "${LAYERDIR}/recipes-*/*/*.bb \
            ${LAYERDIR}/recipes-*/*/*.bbappend"

BBFILE_COLLECTIONS += "meta-poky"
BBFILE_PATTERN_meta-poky := "^${LAYERDIR}/"

#higher priority. If a same recipe exists in poky, we prefer our version.
BBFILE_PRIORITY_meta-poky = "7"
```

## meta-poky/conf/machine/airbox.conf
```bitbake
#@TYPE: Machine
#@NAME: airbox

include igep00x0.inc

MACHINE_FEATURES = "apm usbgadget usbhost vfat bluetooth wifi"
CORE_IMAGE_BASE_EXTRA_INSTALL = "packagegroup-airbox packagegroup-core-ssh-openssh"

# no serial console on the Airbox, it is used by the XBee modem
SERIAL_CONSOLE = ""
```

## meta-poky/conf/machine/ardrone2-installer.conf
```bitbake
#@TYPE: Machine
#@NAME: Parrot Ar Drone 2
#@DESCRIPTION: installer to use with parrot tools and cable. 

# build plf image
INHERIT += "plf-image"

include conf/machine/include/tune-cortexa8.inc

IMAGE_FSTYPES += "plf tar.gz"

SERIAL_CONSOLE = "115200 ttyO3"

PREFERRED_PROVIDER_virtual/kernel ?= "linux-ardrone2"

KERNEL_IMAGETYPE = "zImage"

USE_DEVFS = "0"

BOOT_PARAMS="mtdparts=omap2-nand.0:512K(Pbootloader),8M(Pmain_boot),8M(Pfactory),114176K(Psystem) console=ttyO3,115200 loglevel=8 g_serial.use_acm=0 "

CORE_IMAGE_MINIMAL_EXTRA_INSTALL = "coreutils-minimal ardrone2-flash-scripts packagegroup-core-ssh-dropbear"
```

## meta-poky/conf/machine/ardrone2-updater.conf
```bitbake
#@TYPE: Machine
#@NAME: Parrot Ar Drone 2
#@DESCRIPTION: updater to flash in factory partition. 

# build plf kernel
INHERIT += "plf-kernel"

include conf/machine/include/tune-cortexa8.inc

IMAGE_FSTYPES += "tar.gz"

SERIAL_CONSOLE = "115200 ttyO3"

PREFERRED_PROVIDER_virtual/kernel ?= "linux-ardrone2"

KERNEL_IMAGETYPE = "zImage"

USE_DEVFS = "0"

BOOT_PARAMS="mtdparts=omap2-nand.0:512K(Pbootloader),8M(Pmain_boot),8M(Pfactory),114176K(Psystem) console=ttyO3,115200 loglevel=8 earlyprintk=ttyO3,115200 ubi.mtd=Pfactory,2048 ubi.mtd=Psystem,2048 root=ubi0:factory rootfstype=ubifs parrot5.low_latency=1 mem=80M mpurate=1000 "

CORE_IMAGE_MINIMAL_EXTRA_INSTALL = "ardrone2-flash-scripts init-ardrone2-updater"
```

## meta-poky/conf/machine/ardrone2.conf
```bitbake
#@TYPE: Machine
#@NAME: Parrot Ar Drone 2

# build plf kernel
INHERIT += "plf-kernel"

# Ship all kernel modules by default
MACHINE_EXTRA_RRECOMMENDS = "kernel-modules mtd-utils mtd-utils-ubifs screen nano bash ardrone-firmware-atheros wmiconfig init-cam-ardrone2 init-imu-ardrone2 media-ctl yavta battery-ardrone2"

# Allow for extra depends
#EXTRA_IMAGEDEPENDS += ""

# Uncomment the following line to enable the hard floating point abi. Note that
# this breaks some binary libraries and 3D (neither of which ship with
# meta-yocto). For maximum compatibility, leave this disabled.
#DEFAULTTUNE ?= "cortexa8hf-neon"
include conf/machine/include/tune-cortexa8.inc

IMAGE_FSTYPES += "tar.bz2"

SERIAL_CONSOLE = "115200 ttyO3"

PREFERRED_PROVIDER_virtual/kernel ?= "linux-ardrone2"

KERNEL_IMAGETYPE = "zImage"

MACHINE_FEATURES = "usbgadget usbhost vfat wifi"

CORE_IMAGE_BASE_EXTRA_INSTALL = "packagegroup-uav packagegroup-core-ssh-dropbear"

USE_DEVFS = "0"

BOOT_PARAMS="mtdparts=omap2-nand.0:512K(Pbootloader),8M(Pmain_boot),8M(Pfactory),114176K(Psystem) console=ttyO3,115200 loglevel=8 earlyprintk=ttyO3,115200 ubi.mtd=Pfactory,2048 ubi.mtd=Psystem,2048 root=ubi1:rootfs rootfstype=ubifs parrot5.low_latency=1 mem=80M mpurate=1000 "
```

## meta-poky/conf/machine/beaglebone-blue.conf
```bitbake
#@TYPE: Machine
#@NAME: Beaglebone blue
#@DESCRIPTION: Machine configuration for the Beaglebone blue, used in chroot

SOC_FAMILY = "ti335x"
TARGET_ARCH = "arm"

DEFAULTTUNE ?= "cortexa8hf-neon"

require conf/machine/include/soc-family.inc
require conf/machine/include/tune-cortexa8.inc

#when moving from chroot to real rootfs, remove the bbappend in:
#robomap3-rt/meta-poky/recipes-core/dropbear (which changes dropbear default port)
PREFERRED_PROVIDER_virtual/kernel = "linux-dummy"

#SERIAL_CONSOLE = "115200 ttyO0"

IMAGE_FSTYPES = "tar.xz"

#MACHINE_FEATURES = "ext2 serial usbhost vfat"

MACHINE_EXTRA_RRECOMMENDS = "screen nano bash"
CORE_IMAGE_BASE_EXTRA_INSTALL = "packagegroup-core-ssh-dropbear"
```

## meta-poky/conf/machine/bebop.conf
```bitbake
#@TYPE: Machine
#@NAME: Parrot bebop

# build plf kernel
#INHERIT += "plf-kernel"

MACHINE_EXTRA_RRECOMMENDS = "screen nano bash"

# Allow for extra depends
#EXTRA_IMAGEDEPENDS += ""

# Uncomment the following line to enable the hard floating point abi. Note that
# this breaks some binary libraries and 3D (neither of which ship with
# meta-yocto). For maximum compatibility, leave this disabled.
#DEFAULTTUNE ?= "cortexa8hf-neon"
include conf/machine/include/tune-cortexa8.inc

IMAGE_FSTYPES += "tar.bz2"

PREFERRED_PROVIDER_virtual/kernel = "linux-dummy"

KERNEL_IMAGETYPE = "zImage"

MACHINE_FEATURES = "usbgadget usbhost"

CORE_IMAGE_BASE_EXTRA_INSTALL = "packagegroup-core-ssh-dropbear init-chroot"

USE_DEVFS = "0"
```

## meta-poky/conf/machine/igep00x0.inc
```bitbake
PREFERRED_PROVIDER_virtual/xserver ?= "xserver-xorg"
XSERVER ?= "xserver-xorg \
           xf86-input-evdev \
           xf86-input-mouse \
           xf86-video-omapfb \
           xf86-input-keyboard"

# Ship all kernel modules by default
MACHINE_EXTRA_RRECOMMENDS = "kernel-modules linux-firmware-sd8686 mtd-utils igep-x-loader screen nano bash strace"

# Allow for extra depends
#EXTRA_IMAGEDEPENDS += ""

# Uncomment the following line to enable the hard floating point abi. Note that
# this breaks some binary libraries and 3D (neither of which ship with
# meta-yocto). For maximum compatibility, leave this disabled.
#DEFAULTTUNE ?= "cortexa8hf-neon"
include conf/machine/include/tune-cortexa8.inc

IMAGE_FSTYPES += "tar.bz2 jffs2"
EXTRA_IMAGECMD_jffs2 = "-lnp "

# 2.6.37 and later kernels use OMAP_SERIAL, ttyO2
# earlier kernels use ttyS2
SERIAL_CONSOLE = "115200 ttyO2"

PREFERRED_PROVIDER_virtual/kernel ?= "linux-igep"

KERNEL_IMAGETYPE = "zImage"
```

## meta-poky/conf/machine/mambo-minimal.conf
```bitbake
#@TYPE: Machine
#@NAME: Parrot mambo

include conf/machine/include/tune-arm926ejs.inc

IMAGE_FSTYPES += "tar.gz"

#SERIAL_CONSOLE = "115200 ttyPA1"

PREFERRED_PROVIDER_virtual/kernel ?= "linux-mambo"

KERNEL_IMAGETYPE = "zImage"

MACHINE_FEATURES = "usbgadget usbhost"

USE_DEVFS = "0"

BOOT_PARAMS="parrotparts=nand0:256K(Pbootloader),16M(Pmain_boot),8M(Pfactory),32M(Psystem),73472K(Pupdate) console=ttyPA1,115200 loglevel=5 quiet lpj=1038336 ubi.mtd=Pfactory,2048 ubi.mtd=Psystem,2048 root=ubi1:system rootfstype=ubifs ubi.mtd=Pupdate,2048 "

CORE_IMAGE_MINIMAL_EXTRA_INSTALL = "coreutils-minimal packagegroup-core-ssh-dropbear init-chroot"
```

## meta-poky/conf/machine/mambo.conf
```bitbake
#@TYPE: Machine
#@NAME: Parrot mambo

# build plf kernel
INHERIT += "plf-kernel"

# Ship all kernel modules by default
MACHINE_EXTRA_RRECOMMENDS = "kernel-modules mtd-utils mtd-utils-ubifs screen nano bash us-mambo"

# Allow for extra depends
#EXTRA_IMAGEDEPENDS += ""

include conf/machine/include/tune-arm926ejs.inc

IMAGE_FSTYPES += "tar.gz"

#SERIAL_CONSOLE = "115200 ttyPA1"

PREFERRED_PROVIDER_virtual/kernel ?= "linux-mambo"

KERNEL_IMAGETYPE = "zImage"

MACHINE_FEATURES = "usbgadget usbhost"

CORE_IMAGE_BASE_EXTRA_INSTALL = "packagegroup-core-ssh-dropbear init-chroot"

USE_DEVFS = "0"

BOOT_PARAMS="parrotparts=nand0:256K(Pbootloader),16M(Pmain_boot),8M(Pfactory),32M(Psystem),73472K(Pupdate) console=ttyPA1,115200 loglevel=5 quiet lpj=1038336 ubi.mtd=Pfactory,2048 ubi.mtd=Psystem,2048 root=ubi1:system rootfstype=ubifs ubi.mtd=Pupdate,2048 "
```

## meta-poky/conf/machine/overo.conf
```bitbake
#@TYPE: Machine
#@NAME: overo (uav)

PREFERRED_PROVIDER_virtual/xserver ?= "xserver-xorg"
XSERVER ?= "xserver-xorg \
           xf86-input-evdev \
           xf86-input-mouse \
           xf86-video-omapfb \
           xf86-input-keyboard"

# Ship all kernel modules by default
MACHINE_EXTRA_RRECOMMENDS = "kernel-modules linux-firmware-sd8686 mtd-utils packagegroup-core-ssh-dropbear screen nano bash strace"

# Allow for extra depends
#EXTRA_IMAGEDEPENDS += ""

# Uncomment the following line to enable the hard floating point abi. Note that
# this breaks some binary libraries and 3D (neither of which ship with
# meta-yocto). For maximum compatibility, leave this disabled.
#DEFAULTTUNE ?= "cortexa8hf-neon"
include conf/machine/include/tune-cortexa8.inc

IMAGE_FSTYPES += "tar.bz2 jffs2"
EXTRA_IMAGECMD_jffs2 = "-lnp "

# 2.6.37 and later kernels use OMAP_SERIAL, ttyO2
# earlier kernels use ttyS2
SERIAL_CONSOLE = "115200 ttyO2"

PREFERRED_PROVIDER_virtual/kernel ?= "linux-igep"
#PREFERRED_VERSION_linux-libc-headers ?= "2.6.37"

KERNEL_IMAGETYPE = "uImage"

MACHINE_FEATURES = "usbgadget usbhost vfat bluetooth wifi"
CORE_IMAGE_EXTRA_INSTALL += "packagegroup-uav u-boot x-loader"
```

## meta-poky/conf/machine/pacpus.conf
```bitbake
#@TYPE: Machine
#@NAME: pacpus
DEFAULTTUNE = "armv7a-neon"

include igep00x0.inc

MACHINE_FEATURES = "usbgadget usbhost vfat bluetooth wifi"
CORE_IMAGE_BASE_EXTRA_INSTALL = "packagegroup-pacpus packagegroup-core-ssh-dropbear"


ROOTFS_POSTPROCESS_COMMAND += "rootfs_update_powervr_windowsystem ; "
```

## meta-poky/conf/machine/rpi-hds.conf
```bitbake
#@TYPE: Machine
#@NAME: rpi-hds
#@DESCRIPTION: Machine configuration for the RaspberryPi 3 for HDS environment

include conf/machine/raspberrypi3.conf

MACHINE_FEATURES += "usbgadget"

MACHINE_EXTRA_RRECOMMENDS += "bash"

#add x11 and opengl for utcoupe dependencies, make a separate distro for it??
DISTRO_FEATURES_append =" x11 opengl"

#Add a lot of stuff useful for the rpi
WIFI_SUPPORT = " \
    iw \
    linux-firmware-brcm43430 \
    linux-firmware-ralink \
    linux-firmware-rtl8192ce \
    linux-firmware-rtl8192cu \
    linux-firmware-rtl8192su \
    wireless-tools \
    wpa-supplicant \
"

DEV_EXTRAS = " \
    roslaunch \
    ntp \
    ntp-tickadj \
    serialecho  \
    spiloop \
"

EXTRA_TOOLS_INSTALL = " \
    bzip2 \
    devmem2 \
    dosfstools \
    ethtool \
    findutils \
    iproute2 \
    less \
    memtester \
    nano \
    netcat \
    procps \
    rsync \
    sysfsutils \
    tcpdump \
    unzip \
    util-linux \
    wget \
    zip \
    file \
    htop \
    crda \
"

CORE_IMAGE_BASE_EXTRA_INSTALL += "packagegroup-rpi packagegroup-core-ssh-dropbear ${EXTRA_TOOLS_INSTALL} ${WIFI_SUPPORT} ${DEV_EXTRAS}"

IMAGE_FSTYPES = "rpi-sdimg"
```

## meta-poky/conf/machine/uav.conf
```bitbake
#@TYPE: Machine
#@NAME: uav

include igep00x0.inc

MACHINE_FEATURES = "usbgadget usbhost vfat bluetooth wifi"
CORE_IMAGE_BASE_EXTRA_INSTALL = "packagegroup-core-ssh-dropbear xenomai i2c-omap-rtdm uart-omap-rtdm packagegroup-dsp"
```
